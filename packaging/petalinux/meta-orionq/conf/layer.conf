## packaging/petalinux/meta-orionq/conf/layer.conf
```bitbake
BBPATH .= ":${LAYERDIR}"
BBFILES += "${LAYERDIR}/recipes-*/*/*.bb"
BBFILE_COLLECTIONS += "orionq"
BBFILE_PATTERN_orionq = "^${LAYERDIR}/"
BBFILE_PRIORITY_orionq = "8"
LAYERDEPENDS_orionq = "core openembedded-layer meta-python"
LAYERSERIES_COMPAT_orionq = "scarthgap"
```
